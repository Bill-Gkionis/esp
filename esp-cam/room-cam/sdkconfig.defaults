## esp-cam/room-cam/sdkconfig.defaults
```kconfig
# DEBUG: console on UART0 at 115200 to diagnose camera init
CONFIG_ESP_CONSOLE_UART_DEFAULT=y
CONFIG_ESP_CONSOLE_UART_BAUDRATE=115200

# PSRAM — required for camera frame buffers on AI-Thinker ESP32-CAM
CONFIG_SPIRAM=y
CONFIG_SPIRAM_SPEED_80M=y
CONFIG_SPIRAM_USE_MALLOC=y

# Run at full 240 MHz for camera throughput
CONFIG_ESP_DEFAULT_CPU_FREQ_MHZ_240=y

# 4 MB flash (AI-Thinker ESP32-CAM)
CONFIG_ESPTOOLPY_FLASHSIZE_4MB=y
CONFIG_ESPTOOLPY_FLASHMODE_DIO=y
```
